## lib/boards/arm/nrf52840_m2/Kconfig
```kconfig
# nRF52840-M2 board configuration

# Copyright (c) 2020 makerdiary
# SPDX-License-Identifier: Apache-2.0

if BOARD_NRF52840_M2

config BOARD_ENABLE_DCDC
	bool "Enable DCDC mode"
	select SOC_DCDC_NRF52X
	default y

config BOARD_HAS_NRF5_BOOTLOADER
	bool "Board has nRF5 bootloader"
	default y
	help
	  If selected, applications are linked so that they can be loaded by Nordic
	  nRF5 bootloader.

endif # BOARD_NRF52840_M2
```

## lib/boards/arm/nrf52840_m2/Kconfig.board
```kconfig
# nRF52840-M2 board configuration

# Copyright (c) 2020 makerdiary
# SPDX-License-Identifier: Apache-2.0

config BOARD_NRF52840_M2
	bool "nRF52840-M2"
	depends on SOC_NRF52840_QIAA
```
